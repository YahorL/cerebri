## drivers/synapse/srl_rx/Kconfig
```kconfig
# Copyright (c) 2025, CogniPilot Foundation
# SPDX-License-Identifier: Apache-2.0

config CEREBRI_SYNAPSE_SRL_RX
  bool "serial rx"	
  default y
  depends on ZROS
  help
    This option enables the synapse udp interface

if CEREBRI_SYNAPSE_SRL_RX

module = CEREBRI_SYNAPSE_SRL_RX
module-str = synapse_srl_rx
source "subsys/logging/Kconfig.template.log_config"

endif # CEREBRI_SYNAPSE_SRL_RX
```

## drivers/synapse/srl_tx/Kconfig
```kconfig
# Copyright (c) 2025, CogniPilot Foundation
# SPDX-License-Identifier: Apache-2.0

config CEREBRI_SYNAPSE_SRL_TX
  bool "serial tx"	
  default y
  depends on ZROS
  help
    This option enables the synapse udp interface

if CEREBRI_SYNAPSE_SRL_TX

module = CEREBRI_SYNAPSE_SRL_TX
module-str = synapse_srl_tx
source "subsys/logging/Kconfig.template.log_config"

endif # CEREBRI_SYNAPSE_SRL_TX
```
